# GD32W515Px register map
File version: 1.0
GD32W515 ARM 32-bit Cortex-M33 Microcontroller based device
CPU: CM33 r0p0, little endian, MPU, FPU, 4 interrupt priority bits
Registers are 32-bit, read-write, reset 0x0 unless marked. A register's access mark holds for its fields unless they carry their own. Offsets are from the block's base; lines under a group give offsets from that group; [hi:lo] are bit positions; {n}, {i} and the like mark numbered series; 'fields as' and 'values as' point back to an identical list; <NAME> marks a mode.

## Memory map
0x40000000 TIMER1 size 0x400 — General-level0-timer
0x40000400 TIMER2 size 0x400 — General-purpose-timers
0x40000800 TIMER3 size 0x400 — General-level0-timer
0x40000C00 TIMER4 size 0x400 — General-purpose-timers
0x40001000 TIMER5 size 0x400 — Basic-timers
0x40002800 RTC size 0x400 — Real-time clock
0x40002C00 WWDGT size 0x400 — Window watchdog timer
0x40003000 FWDGT size 0x400 — free watchdog timer
0x40003400 I2S1_add size 0x400
0x40003800 SPI1 size 0x400 — Serial peripheral interface
0x40004400 USART1 size 0x400 — Universal synchronous asynchronous receiver transmitter
0x40004800 USART0 size 0x400 — Universal synchronous asynchronous receiver transmitter
0x40005400 I2C0 size 0x400 — Inter integrated circuit
0x40005800 I2C1 size 0x400 — Inter integrated circuit
0x40007000 PMU size 0x400 — Power management unit
0x40010000 TIMER0 size 0x400 — Advanced-timers
0x40011000 USART2 size 0x400 — Universal synchronous asynchronous receiver transmitter
0x40012000 ADC size 0x400 — Analog to digital converter
0x40012C00 SDIO size 0x400 — Secure digital input/output interface
0x40013000 SPI0 size 0x400 — Serial peripheral interface
0x40013800 SYSCFG size 0x400 — System configuration controller
0x40013C00 EXTI size 0x400 — External interrupt/event controller
0x40016000 HPDF size 0x400 — High-Performance Digital Filter
0x40018000 TIMER15 size 0x400 — General-purpose-timers
0x40018400 TIMER16 size 0x400 — General-purpose-timers
0x40020000 GPIOA size 0x400 — General-purpose I/Os
0x40020400 GPIOB size 0x400 — General-purpose I/Os
0x40020800 GPIOC size 0x400 — General-purpose I/Os
0x40022000 FMC size 0x400
0x40022800 EFUSE size 0x400
0x40023000 CRC size 0x400 — cyclic redundancy check calculation unit
0x40023800 RCU size 0x400 — Reset and clock unit
0x40024000 TSI size 0x400 — Touch sensing Interface
0x40025400 SQPI size 0x400 — Serial/Quad Parallel Interface
0x40025800 QSPI size 0x400 — Quad-SPI interface
0x40026000 DMA0 size 0x400 — DMA controller
0x40026400 DMA1 size 0x400 — DMA controller
0x40080000 ICACHE size 0x400
0x400A0000 TZSPC size 0x400 — TrustZone security controller
0x400A0400 TZIAC size 0x400 — TrustZone illegal access controller
0x400A0800 TZBMPC0 size 0x400 — Memory protection controller - block based
0x400A0C00 TZBMPC1 size 0x400 — Memory protection controller - block based
0x400B0000 TZBMPC2 size 0x400 — Memory protection controller - block based
0x400B0400 TZBMPC3 size 0x400 — Memory protection controller - block based
0x49000000 FS_GLOBAL size 0x400 — USB full speed global registers
0x49000400 FS_HOST size 0x400 — USB on the go full speed host
0x49000800 FS_DEVICE size 0x400 — USB on the go full speed device
0x49000E00 FS_PWRCLK size 0x100 — USB on the go full speed
0x4C050000 DCI size 0x400 — Digital Camera Interface
0x4C060000 CAU size 0x400 — Cryptographic acceleration unit
0x4C060400 HAU size 0x400 — HAU acceleration unit
0x4C060800 TRNG size 0x400 — Ture random number generator
0x4C061000 PKCAU size 0x400 — Public Key Cryptographic Acceleration Unit
0x50000000 SEC_TIMER1 size 0x400
0x50000400 SEC_TIMER2 size 0x400
0x50000800 SEC_TIMER3 size 0x400
0x50000C00 SEC_TIMER4 size 0x400
0x50001000 SEC_TIMER5 size 0x400
0x50002800 SEC_RTC size 0x400
0x50002C00 SEC_WWDGT size 0x400
0x50003000 SEC_FWDGT size 0x400
0x50003400 SEC_I2S1_add size 0x400
0x50003800 SEC_SPI1 size 0x400
0x50004400 SEC_USART1 size 0x400
0x50004800 SEC_USART0 size 0x400
0x50005400 SEC_I2C0 size 0x400
0x50005800 SEC_I2C1 size 0x400
0x50007000 SEC_PMU size 0x400
0x50010000 SEC_TIMER0 size 0x400
0x50011000 SEC_USART2 size 0x400
0x50012000 SEC_ADC size 0x400
0x50012C00 SEC_SDIO size 0x400
0x50013000 SEC_SPI0 size 0x400
0x50013800 SEC_SYSCFG size 0x400
0x50013C00 SEC_EXTI size 0x400
0x50016000 SEC_HPDF size 0x400
0x50018000 SEC_TIMER15 size 0x400
0x50018400 SEC_TIMER16 size 0x400
0x50020000 SEC_GPIOA size 0x400
0x50020400 SEC_GPIOB size 0x400
0x50020800 SEC_GPIOC size 0x400
0x50022000 SEC_FMC size 0x400
0x50022800 SEC_EFUSE size 0x400
0x50023000 SEC_CRC size 0x400
0x50023800 SEC_RCU size 0x400
0x50024000 SEC_TSI size 0x400
0x50025400 SEC_SQPI size 0x400
0x50025800 SEC_QSPI size 0x400
0x50026000 SEC_DMA0 size 0x400
0x50026400 SEC_DMA1 size 0x400
0x50080000 SEC_ICACHE size 0x400
0x500A0000 SEC_TZSPC size 0x400
0x500A0400 SEC_TZIAC size 0x400
0x500A0800 SEC_TZBMPC0 size 0x400
0x500A0C00 SEC_TZBMPC1 size 0x400
0x500B0000 SEC_TZBMPC2 size 0x400
0x500B0400 SEC_TZBMPC3 size 0x400
0x59000000 SEC_FS_GLOBAL size 0x400
0x59000400 SEC_FS_HOST size 0x400
0x59000800 SEC_FS_DEVICE size 0x400
0x59000E00 SEC_FS_PWRCLK size 0x100
0x5C050000 SEC_DCI size 0x400
0x5C060000 SEC_CAU size 0x400
0x5C060400 SEC_HAU size 0x400
0x5C060800 SEC_TRNG size 0x400
0x5C061000 SEC_PKCAU size 0x400
0xE000EE08 DCB size 0x5 — Debug Control Block
0xE0044000 DBG size 0x400 — Debug support

## Interrupts
0 WWDGT
2 RTC_Tamper (RTC)
3 RTC_WKUP (RTC)
4 FMC
5 RCU
6 EXTI_Line0 (EXTI)
7 EXTI_Line1 (EXTI)
8 EXTI_Line2 (EXTI)
9 EXTI_Line3 (EXTI)
10 EXTI_Line4 (EXTI)
{n+11} DMA0_Channel{n} (DMA0) (n=0..7)
19 ADC
20 RTC_Tamper_SEC (RTC)
21 RTC_WKUP_SEC (RTC)
22 RTC_Alarm_SEC (RTC)
23 EXTI_line9_5 (EXTI)
24 TIMER0_BRK (TIMER0)
25 TIMER0_UP (TIMER0)
26 TIMER0COM (TIMER0)
27 TIMER0_CC (TIMER0)
28 TIMER1
29 TIMER2
30 TIMER3
31 I2C0_EV (I2C0)
32 I2C0_ER (I2C0)
33 I2C1_EV (I2C1)
34 I2C1_ER (I2C1)
35 SPI0
36 SPI1
37 USART0
38 USART1
39 USART2
40 EXTI_line15_10 (EXTI)
41 RTC_Alarm (RTC)
44 TIMER15
45 TIMER16
49 SDIO
50 TIMER4
51 I2C0_WK (I2C0)
52 USART0_WK (USART0)
53 USART2_WK (USART2)
54 TIMER5
{n+56} DMA1_Channel{n} (DMA1) (n=0..7)
67 USB_FS (FS_GLOBAL)
76 USB_FS_WKUP (FS_GLOBAL)
78 DCI
79 CAU
80 HAU_TRNG (TRNG, HAU)
89 HPDF0 (HPDF)
90 HPDF1 (HPDF)
94 EFUSE
95 QSPI
96 PKCAU
97 TSI
98 ICACHE
99 TZIAC
100 FMC_SEC (FMC)
101 QSPI_SEC (QSPI)
